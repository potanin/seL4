/*
 * Copyright 2025
 *
 * SPDX-License-Identifier: GPL-2.0-only
 */

/ {
	chosen {
		seL4,elfloader-devices =
		    &{/serial@c280000},
		    &{/psci},
		    &{/timer};
		seL4,kernel-devices =
		    &{/serial@c280000},
		    &{/bus@0/interrupt-controller@f400000},
		    &{/timer};
	};

	memory@80000000 {
		device_type = "memory";
		/*
		 * DRAM: 0x80000000 - 0x280000000 (8 GB, Non-ECC).
		 * Firmware carve-out CO:43 at 0xbe000000 (64 MB) is
		 * hardware-protected — accessing it triggers RAS errors.
		 * Declare two regions that skip the carve-out so it
		 * doesn't become a device untyped.
		 */
		reg = <0x00 0x80000000 0x00 0x3e000000   /* 992 MB before carve-out */
		       0x00 0xc2000000 0x00 0x3e000000>; /* 992 MB after carve-out */
	};

	/*
	 * UARTC — AON-domain debug UART on J14 button header.
	 * J14 Pin 3=RXD, Pin 4=TXD, Pin 7=GND, 3.3V levels.
	 * SoC pads: GP11_UART3_TXD, GP12_UART3_RXD.
	 */
	serial@c280000 {
		compatible = "nvidia,tegra194-hsuart";
		reg = <0x00 0x0c280000 0x00 0x10000>;
		interrupts = <0x00 0x72 0x04>; /* SPI 114, level high */
		clocks = <0x03 0x9d>;          /* TEGRA234_CLK_UARTC = 157 */
		resets = <0x03 0x66>;          /* TEGRA234_RESET_UARTC = 102 */
		reset-names = "serial";
		status = "okay";
	};
};
